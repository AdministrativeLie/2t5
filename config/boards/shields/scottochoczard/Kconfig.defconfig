## config/boards/shields/scottochoczard/Kconfig.defconfig
```kconfig
if SHIELD_SCOTTOCHOCZARD_LEFT

config ZMK_KEYBOARD_NAME
    default "ScottoChoczard"

config ZMK_SPLIT_ROLE_CENTRAL
    default y

endif

if SHIELD_SCOTTOCHOCZARD_LEFT || SHIELD_SCOTTOCHOCZARD_RIGHT

config ZMK_SPLIT
    default y


endif

if ZMK_DISPLAY

config I2C
    default y

config SSD1306
    default y

endif # ZMK_DISPLAY
```

## config/west.yml
```yaml
manifest:
  remotes:
    - name: zmkfirmware
      url-base: https://github.com/zmkfirmware
    - name: caksoylar
      url-base: https://github.com/caksoylar
    - name: dhruvinsh
      url-base: https://github.com/dhruvinsh
    - name: englmaxi
      url-base: https://github.com/englmaxi
    - name: mctechnology17
      url-base: https://github.com/mctechnology17
  projects:
    - name: zmk
      remote: zmkfirmware
      revision: main
      import: app/west.yml
      
    # modules
    - name: zmk-rgbled-widget
      remote: caksoylar
      revision: main
    - name: zmk-tri-state
      remote: dhruvinsh
      revision: main
    - name: zmk-dongle-display
      remote: englmaxi
      revision: main
    - name: zmk-oled-adapter
      remote: mctechnology17
      revision: main
  self:
    path: config
```
